## arch/arm/mach-msm/pantech/data/Kconfig
```kconfig
#ifdef FEATURE_SKY_DS_KERNEL_CONFIG

if CUST_PANTECH_H

menu "SKY Data Kernel Configuration"

config SKY_DS_DEFAULT_CONGESTION_CONTROL
	bool "default congestion control setting"
	default y
	select TCP_CONG_ADVANCED
	select DEFAULT_BIC
	select TCP_CONG_BIC
	help

config DEFAULT_TCP_CONG
	string
	depends on SKY_DS_DEFAULT_CONGESTION_CONTROL
	default "bic"
	help

config SKY_DS_TETHEER_MSS
	bool "enable CONFIG_NETFILTER about TCP MSS"
	default y
	select NETFILTER_XT_TARGET_TCPMSS
	select NETFILTER_XT_MATCH_TCPMSS
	help

config SKY_DS_VPN
	bool "VPN"
	default y
	select NET_KEY
	select INET_ESP
	select INET_IPCOMP
	select XFRM
	select XFRM_USER
	select INET_XFRM_MODE_TRANSPORT
	select INET_XFRM_MODE_TUNNEL
	select CRYPTO
	select CRYPTO_HMAC
	select CRYPTO_XCBC
	select CRYPTO_NULL
	select CRYPTO_MD5
	select CRYPTO_SHA1
	select CRYPTO_DES
	select CRYPTO_AES
	select CRYPTO_DEFLATE
	select IP_ADVANCED_ROUTER
	select IP_MULTIPLE_TABLES
	select PPP
	select PPP_ASYNC
	select PPP_SYNC_TTY
	select PPP_DEFLATE
	select PPP_BSDCOMP
	select PPP_MPPE
	select PPPOE
	select PPPOL2TP
	select L2TP
	select L2TP_V3
	select L2TP_IP
	select L2TP_ETH
	select PPPOLAC
	select PPPOPNS
	help

config SKY_DS_IPSEC
	bool "enable INET CONFIG for IP SEC"
	default y
	select INET_AH
	select INET_XFRM_TUNNEL
	help

config SKY_DS_SUPPORT_TUN
	bool "support for tun driver"
	default y
	select TUN
	help

config SKY_DS_SUPPORT_BACKGROUND_TRFFIC_CONTROL_AGENT
	bool "support for advanced netfilter"
	default y
	select NETFILTER_ADVANCED
	help

config SKY_DS_CTS_LOCALHOST
	bool "support for traffic statistic each uid"
	default y
	select UID_STAT
	help

config SKY_DS_BAM_ADAPTIVE_TIMER_OFF
	bool "BAN ADAPTIVE TIMER DISABLE"
	default y
	help
	  DL Throughput

config SKY_DS_CHANGE_RNDIS_MTU
	bool "changed rndis mtu size to 1440"
	default y
	help

config SKY_DS_ACCEPT_SIP_LAGRE_PACKET
	bool "accept SIP packet over MTU size"
	default y
	help

config SKY_DS_TCP_INIFINITE_LOOP_BUG_FIX
	bool "avoid infinite loop on recvmsg by tcp"
	default y
	help

config SKY_DS_KERNEL_CRASH_DUT_TO_NULL_POINTER
	bool "kernel crash due to null pointer dereference security patch 2013-6432"
	default y
	help

config SKY_DS_OPTIMIZE_IPV6_ASSIGNMENT
	bool "IPv6 Address Asignment"
	default y
	help

config SKY_DS_OPTIMIZE_IPV6_ASSIGNMENT_CRASH_FIX
	bool "Prevent device from crashing"
	depends on SKY_DS_OPTIMIZE_IPV6_ASSIGNMENT
	default y
	help
	  Device crashed when optimizing IPv6 address assignment which means reducing assignment duration.
	  It's crashed because 'ifa->idev' is null at 'if6_get_first' function.

config SKY_DS_ANDROID_SECURITY_PATCH_CVE_2014_2851
	bool "net: ipv4: current group_info should be put after using."
	default y
	help
	  Plug a group_info refcount leak in ping_init.
	  group_info is only needed during initialization and
	  the code failed to release the reference on exit.
	  While here move grabbing the reference to a place
	  where it is actually needed.

config SKY_DS_ANDROID_SECURITY_PATCH_CVE_2014_4943
	bool "Arbitrary kernel code execution via PPPOL2TP -ID: CVE-2014-4943"
	default y
	help
	  Since this can never have worked so nobody could possibly have depended
	  on that functionality, just remove the broken code and return -EINVAL.

endmenu

endif

#endif /* FEATURE_SKY_DS_KERNEL_CONFIG */
```
